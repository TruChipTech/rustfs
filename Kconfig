## configs/minimal_defconfig
```kconfig
# <purpose of file>
#
# Copyright (C) 2026 by Anandkumar  <Truchip >
#
# Licensed under MIT
# RustFS minimal configuration — init only
CONFIG_STATIC=y
CONFIG_INIT=y
CONFIG_INIT_RUSTFS=y
# CONFIG_INIT_SYSVINIT is not set
# CONFIG_INIT_SYSTEMD is not set
CONFIG_MDEV=y
# CONFIG_UDEV is not set
CONFIG_APPLET_CAT=y
CONFIG_APPLET_CP=y
CONFIG_APPLET_MV=y
CONFIG_APPLET_RM=y
CONFIG_APPLET_MKDIR=y
# CONFIG_APPLET_RMDIR is not set
CONFIG_APPLET_LS=y
CONFIG_APPLET_TOUCH=y
CONFIG_APPLET_LN=y
CONFIG_APPLET_CHMOD=y
# CONFIG_APPLET_HEAD is not set
# CONFIG_APPLET_TAIL is not set
# CONFIG_APPLET_TEE is not set
# CONFIG_APPLET_WC is not set
# CONFIG_APPLET_DU is not set
# CONFIG_APPLET_DF is not set
# CONFIG_APPLET_STAT is not set
# CONFIG_APPLET_READLINK is not set
CONFIG_APPLET_ECHO=y
# CONFIG_APPLET_PRINTF is not set
CONFIG_APPLET_GREP=y
CONFIG_APPLET_SED=y
# CONFIG_APPLET_SORT is not set
# CONFIG_APPLET_UNIQ is not set
# CONFIG_APPLET_TR is not set
# CONFIG_APPLET_CUT is not set
# CONFIG_APPLET_PASTE is not set
# CONFIG_APPLET_FOLD is not set
# CONFIG_APPLET_REV is not set
# CONFIG_APPLET_NL is not set
# CONFIG_APPLET_BASENAME is not set
# CONFIG_APPLET_DIRNAME is not set
CONFIG_APPLET_PWD=y
# CONFIG_APPLET_REALPATH is not set
# CONFIG_APPLET_BASE64 is not set
# CONFIG_APPLET_MD5SUM is not set
# CONFIG_APPLET_SHA256SUM is not set
# CONFIG_APPLET_XXD is not set
CONFIG_APPLET_UNAME=y
CONFIG_APPLET_HOSTNAME=y
# CONFIG_APPLET_WHOAMI is not set
CONFIG_APPLET_ID=y
# CONFIG_APPLET_UPTIME is not set
CONFIG_APPLET_DATE=y
CONFIG_APPLET_ENV=y
# CONFIG_APPLET_PRINTENV is not set
CONFIG_APPLET_SLEEP=y
# CONFIG_APPLET_YES is not set
CONFIG_APPLET_TRUE=y
CONFIG_APPLET_FALSE=y
# CONFIG_APPLET_NOHUP is not set
# CONFIG_APPLET_SEQ is not set
CONFIG_APPLET_TTY=y
CONFIG_APPLET_WHICH=y
# CONFIG_APPLET_XARGS is not set
CONFIG_APPLET_FIND=y
CONFIG_APPLET_TEST=y
# CONFIG_APPLET_EXPR is not set
# CONFIG_APPLET_ADDGROUP is not set
# CONFIG_APPLET_ADDUSER is not set
# CONFIG_APPLET_AR is not set
# CONFIG_APPLET_ARP is not set
# CONFIG_APPLET_ARPING is not set
# CONFIG_APPLET_AWK is not set
# CONFIG_APPLET_BLKID is not set
# CONFIG_APPLET_BUNZIP2 is not set
# CONFIG_APPLET_BZCAT is not set
# CONFIG_APPLET_BZIP2 is not set
# CONFIG_APPLET_CHGRP is not set
# CONFIG_APPLET_CHOWN is not set
CONFIG_APPLET_CLEAR=y
# CONFIG_APPLET_DD is not set
# CONFIG_APPLET_DELGROUP is not set
# CONFIG_APPLET_DELUSER is not set
# CONFIG_APPLET_DIFF is not set
# CONFIG_APPLET_DMESG is not set
# CONFIG_APPLET_DOS2UNIX is not set
# CONFIG_APPLET_FBSET is not set
# CONFIG_APPLET_FDISK is not set
# CONFIG_APPLET_FSCK is not set
CONFIG_APPLET_SH=y
CONFIG_APPLET_PS=y
CONFIG_APPLET_FREE=y
CONFIG_APPLET_SYNC=y
CONFIG_APPLET_MKTEMP=y
CONFIG_APPLET_NPROC=y
CONFIG_APPLET_TAC=y
CONFIG_APPLET_TIMEOUT=y
# CONFIG_APPLET_OD is not set
CONFIG_APPLET_TRUNCATE=y
# CONFIG_APPLET_STRINGS is not set
# CONFIG_APPLET_CMP is not set
```

## configs/systemd_defconfig
```kconfig
# <purpose of file>
#
# Copyright (C) 2026 by Anandkumar  <Truchip >
#
# Licensed under MIT
# RustFS systemd-compatible init configuration — all features enabled
CONFIG_INIT=y
# CONFIG_INIT_RUSTFS is not set
# CONFIG_INIT_SYSVINIT is not set
CONFIG_INIT_SYSTEMD=y
CONFIG_MDEV=y
# CONFIG_UDEV is not set
CONFIG_APPLET_CAT=y
CONFIG_APPLET_CP=y
CONFIG_APPLET_MV=y
CONFIG_APPLET_RM=y
CONFIG_APPLET_MKDIR=y
CONFIG_APPLET_RMDIR=y
CONFIG_APPLET_LS=y
CONFIG_APPLET_TOUCH=y
CONFIG_APPLET_LN=y
CONFIG_APPLET_CHMOD=y
CONFIG_APPLET_HEAD=y
CONFIG_APPLET_TAIL=y
CONFIG_APPLET_TEE=y
CONFIG_APPLET_WC=y
CONFIG_APPLET_DU=y
CONFIG_APPLET_DF=y
CONFIG_APPLET_STAT=y
CONFIG_APPLET_READLINK=y
CONFIG_APPLET_ECHO=y
CONFIG_APPLET_PRINTF=y
CONFIG_APPLET_GREP=y
CONFIG_APPLET_SED=y
CONFIG_APPLET_SORT=y
CONFIG_APPLET_UNIQ=y
CONFIG_APPLET_TR=y
CONFIG_APPLET_CUT=y
CONFIG_APPLET_PASTE=y
CONFIG_APPLET_FOLD=y
CONFIG_APPLET_REV=y
CONFIG_APPLET_NL=y
CONFIG_APPLET_BASENAME=y
CONFIG_APPLET_DIRNAME=y
CONFIG_APPLET_PWD=y
CONFIG_APPLET_REALPATH=y
CONFIG_APPLET_BASE64=y
CONFIG_APPLET_MD5SUM=y
CONFIG_APPLET_SHA256SUM=y
CONFIG_APPLET_XXD=y
CONFIG_APPLET_UNAME=y
CONFIG_APPLET_HOSTNAME=y
CONFIG_APPLET_WHOAMI=y
CONFIG_APPLET_ID=y
CONFIG_APPLET_UPTIME=y
CONFIG_APPLET_DATE=y
CONFIG_APPLET_ENV=y
CONFIG_APPLET_PRINTENV=y
CONFIG_APPLET_SLEEP=y
CONFIG_APPLET_YES=y
CONFIG_APPLET_TRUE=y
CONFIG_APPLET_FALSE=y
CONFIG_APPLET_NOHUP=y
CONFIG_APPLET_SEQ=y
CONFIG_APPLET_TTY=y
CONFIG_APPLET_WHICH=y
CONFIG_APPLET_XARGS=y
CONFIG_APPLET_FIND=y
CONFIG_APPLET_TEST=y
CONFIG_APPLET_EXPR=y
CONFIG_APPLET_ADDGROUP=y
CONFIG_APPLET_ADDUSER=y
CONFIG_APPLET_AR=y
CONFIG_APPLET_ARP=y
CONFIG_APPLET_ARPING=y
CONFIG_APPLET_AWK=y
CONFIG_APPLET_BLKID=y
CONFIG_APPLET_BUNZIP2=y
CONFIG_APPLET_BZCAT=y
CONFIG_APPLET_BZIP2=y
CONFIG_APPLET_CHGRP=y
CONFIG_APPLET_CHOWN=y
CONFIG_APPLET_CLEAR=y
CONFIG_APPLET_DD=y
CONFIG_APPLET_DELGROUP=y
CONFIG_APPLET_DELUSER=y
CONFIG_APPLET_DIFF=y
CONFIG_APPLET_DMESG=y
CONFIG_APPLET_DOS2UNIX=y
CONFIG_APPLET_FBSET=y
CONFIG_APPLET_FDISK=y
CONFIG_APPLET_FSCK=y
CONFIG_APPLET_FSYNC=y
CONFIG_APPLET_FTPD=y
CONFIG_APPLET_FTPGET=y
CONFIG_APPLET_FTPPUT=y
CONFIG_APPLET_FUSER=y
CONFIG_APPLET_GETOPT=y
CONFIG_APPLET_GETTY=y
CONFIG_APPLET_GUNZIP=y
CONFIG_APPLET_GZIP=y
CONFIG_APPLET_HD=y
CONFIG_APPLET_HEXDUMP=y
CONFIG_APPLET_HOSTID=y
CONFIG_APPLET_HTTPD=y
CONFIG_APPLET_HWCLOCK=y
CONFIG_APPLET_IFCONFIG=y
CONFIG_APPLET_IFDOWN=y
CONFIG_APPLET_IFUP=y
CONFIG_APPLET_INSMOD=y
CONFIG_APPLET_INSTALL=y
CONFIG_APPLET_IP=y
CONFIG_APPLET_IPADDR=y
CONFIG_APPLET_IPCALC=y
CONFIG_APPLET_IPCRM=y
CONFIG_APPLET_IPCS=y
CONFIG_APPLET_KILL=y
CONFIG_APPLET_KILLALL=y
CONFIG_APPLET_KLOGD=y
CONFIG_APPLET_LAST=y
CONFIG_APPLET_LENGTH=y
CONFIG_APPLET_LESS=y
CONFIG_APPLET_LOGGER=y
CONFIG_APPLET_LOGIN=y
CONFIG_APPLET_LOGNAME=y
CONFIG_APPLET_LOGREAD=y
CONFIG_APPLET_LOSETUP=y
CONFIG_APPLET_LSMOD=y
CONFIG_APPLET_MOUNT=y
CONFIG_APPLET_UMOUNT=y
CONFIG_APPLET_RMMOD=y
CONFIG_APPLET_DEPMOD=y
CONFIG_APPLET_MODPROBE=y
CONFIG_APPLET_MODINFO=y
CONFIG_APPLET_SH=y
```
