## Kconfig
```kconfig
# <purpose of file>
#
# Copyright (C) 2026 by Anandkumar  <Truchip >
#
# Licensed under MIT
mainmenu "RustFS Configuration"

menu "Init System"

config INIT
    bool "Enable init applet"
    default y
    help
      Enable the init applet, allowing RustFS to serve as PID 1
      (the first userspace process started by the Linux kernel).

choice
    prompt "Init system type"
    depends on INIT
    default INIT_RUSTFS

config INIT_RUSTFS
    bool "RustFS init (simple init)"
    help
      Simple, lightweight init similar in spirit to minimal init
      implementations. Reads /etc/inittab, manages process spawning
      and respawning, mounts essential filesystems, and runs
      rc scripts. Ideal for embedded systems and containers.

config INIT_SYSVINIT
    bool "System V init"
    help
      Full System V init support. Parses /etc/inittab and manages
      runlevels (0-6, S). Supports respawn, wait, once, sysinit,
      boot, bootwait, ctrlaltdel, shutdown, and restart actions.
      Provides telinit functionality for runlevel switching.

config INIT_SYSTEMD
    bool "systemd-compatible init"
    help
      systemd-compatible init. Parses .service unit files from
      /etc/systemd/system/ and /usr/lib/systemd/system/.
      Supports Type=simple, forking, oneshot. Handles ExecStart,
      ExecStop, Restart, WantedBy, After, and Requires directives.
      Resolves service dependencies and starts them in order.

endchoice

endmenu

menu "Device Manager"

config MDEV
    bool "mdev — lightweight device manager"
    default y
    help
      Lightweight device manager that handles hotplug events from
      the kernel via /sys. Reads /etc/mdev.conf for device node
      creation rules (permissions, ownership, symlinks, scripts).
      Suitable for embedded systems and minimal rootfs setups.

config UDEV
    bool "udev — full device manager"
    default n
    help
      udev-compatible device manager. Listens on a netlink socket
      for kernel uevents and creates/removes device nodes in /dev.
      Reads rules from /etc/udev/rules.d/ and /usr/lib/udev/rules.d/.
      Supports SUBSYSTEM, KERNEL, ATTR, SYMLINK, RUN, MODE, OWNER,
      GROUP, and ENV matching/assignment keys.

endmenu

menu "File Operations"

config APPLET_CAT
    bool "cat"
    default y

config APPLET_CP
    bool "cp"
    default y

config APPLET_MV
    bool "mv"
    default y

config APPLET_RM
    bool "rm"
    default y

config APPLET_MKDIR
    bool "mkdir"
    default y

config APPLET_RMDIR
    bool "rmdir"
    default y

config APPLET_LS
    bool "ls"
    default y

config APPLET_TOUCH
    bool "touch"
    default y

config APPLET_LN
    bool "ln"
    default y

config APPLET_CHMOD
    bool "chmod"
    default y

config APPLET_HEAD
    bool "head"
    default y

config APPLET_TAIL
    bool "tail"
    default y

config APPLET_TEE
    bool "tee"
    default y

config APPLET_WC
    bool "wc"
    default y

config APPLET_DU
    bool "du"
    default y

config APPLET_DF
    bool "df"
    default y

config APPLET_STAT
    bool "stat"
    default y

config APPLET_READLINK
    bool "readlink"
    default y

config APPLET_CHGRP
    bool "chgrp"
    default y

config APPLET_CHOWN
    bool "chown"
    default y

config APPLET_DD
    bool "dd"
    default y

endmenu

menu "Text Processing"

config APPLET_ECHO
    bool "echo"
    default y

config APPLET_PRINTF
    bool "printf"
    default y

config APPLET_GREP
    bool "grep"
    default y

config APPLET_SED
    bool "sed"
    default y

config APPLET_SORT
    bool "sort"
    default y

config APPLET_UNIQ
    bool "uniq"
    default y

config APPLET_TR
    bool "tr"
    default y

config APPLET_CUT
    bool "cut"
    default y

config APPLET_PASTE
    bool "paste"
    default y

config APPLET_FOLD
    bool "fold"
    default y

config APPLET_REV
    bool "rev"
    default y

config APPLET_NL
    bool "nl"
    default y

config APPLET_AWK
    bool "awk"
    default y

config APPLET_DIFF
    bool "diff"
    default y

config APPLET_DOS2UNIX
    bool "dos2unix"
    default y

endmenu

menu "Path / String"

config APPLET_BASENAME
    bool "basename"
    default y

config APPLET_DIRNAME
    bool "dirname"
    default y

config APPLET_PWD
    bool "pwd"
    default y

config APPLET_REALPATH
    bool "realpath"
    default y

endmenu

menu "Encoding / Hashing"

config APPLET_BASE64
    bool "base64"
    default y

config APPLET_MD5SUM
    bool "md5sum"
    default y

config APPLET_SHA256SUM
    bool "sha256sum"
    default y

config APPLET_XXD
    bool "xxd"
    default y

endmenu

menu "System Info"

config APPLET_UNAME
    bool "uname"
    default y

config APPLET_HOSTNAME
    bool "hostname"
    default y

config APPLET_WHOAMI
    bool "whoami"
    default y

config APPLET_ID
    bool "id"
    default y

config APPLET_UPTIME
    bool "uptime"
    default y

config APPLET_DATE
    bool "date"
    default y

config APPLET_ENV
    bool "env"
    default y

config APPLET_PRINTENV
    bool "printenv"
    default y

endmenu

menu "Process / Misc"

config APPLET_SLEEP
    bool "sleep"
    default y

config APPLET_YES
    bool "yes"
    default y

config APPLET_TRUE
    bool "true"
    default y

config APPLET_FALSE
    bool "false"
    default y

config APPLET_NOHUP
    bool "nohup"
    default y

config APPLET_SEQ
    bool "seq"
    default y

config APPLET_TTY
    bool "tty"
    default y

config APPLET_WHICH
    bool "which"
    default y

config APPLET_XARGS
    bool "xargs"
    default y

config APPLET_FIND
    bool "find"
    default y

config APPLET_TEST
    bool "test"
    default y

config APPLET_EXPR
    bool "expr"
    default y

config APPLET_FUSER
    bool "fuser"
    default y

config APPLET_GETTY
    bool "getty"
    default y

config APPLET_GETOPT
    bool "getopt"
    default y

config APPLET_KILL
    bool "kill"
    default y

config APPLET_KILLALL
    bool "killall"
    default y

config APPLET_LAST
    bool "last"
    default y

config APPLET_LENGTH
    bool "length"
    default y

config APPLET_LESS
    bool "less"
    default y

config APPLET_LOGGER
    bool "logger"
    default y

config APPLET_LOGIN
    bool "login"
    default y

config APPLET_LOGNAME
    bool "logname"
    default y

config APPLET_LOGREAD
    bool "logread"
    default y

config APPLET_IPCRM
    bool "ipcrm"
    default y

config APPLET_IPCS
    bool "ipcs"
    default y

endmenu

menu "User / Group Management"

config APPLET_ADDGROUP
    bool "addgroup"
    default y

config APPLET_ADDUSER
    bool "adduser"
    default y

config APPLET_DELGROUP
    bool "delgroup"
    default y

config APPLET_DELUSER
    bool "deluser"
    default y

endmenu

menu "Networking"

config APPLET_ARP
    bool "arp"
    default y

config APPLET_ARPING
    bool "arping"
    default y

config APPLET_FTPD
    bool "ftpd"
    default y

config APPLET_FTPGET
    bool "ftpget"
    default y

config APPLET_FTPPUT
    bool "ftpput"
    default y

config APPLET_HTTPD
    bool "httpd"
    default y

config APPLET_IFCONFIG
    bool "ifconfig"
    default y

config APPLET_IFDOWN
    bool "ifdown"
    default y

config APPLET_IFUP
    bool "ifup"
    default y

config APPLET_IP
    bool "ip"
    default y

config APPLET_IPADDR
    bool "ipaddr"
    default y

config APPLET_IPCALC
    bool "ipcalc"
    default y

endmenu

menu "Archive / Compression"

config APPLET_AR
    bool "ar"
    default y

config APPLET_BUNZIP2
    bool "bunzip2"
    default y

config APPLET_BZCAT
    bool "bzcat"
    default y

config APPLET_BZIP2
    bool "bzip2"
    default y

config APPLET_GUNZIP
    bool "gunzip"
    default y

config APPLET_GZIP
    bool "gzip"
    default y

endmenu

menu "Disk / System Utilities"

config APPLET_BLKID
    bool "blkid"
    default y

config APPLET_CLEAR
    bool "clear"
    default y

config APPLET_DMESG
    bool "dmesg"
    default y

config APPLET_FBSET
    bool "fbset"
    default y

config APPLET_FDISK
    bool "fdisk"
    default y

config APPLET_FSCK
    bool "fsck"
    default y

config APPLET_FSYNC
    bool "fsync"
    default y

config APPLET_HWCLOCK
    bool "hwclock"
    default y

config APPLET_INSMOD
    bool "insmod"
    default y

config APPLET_INSTALL
    bool "install"
    default y

config APPLET_KLOGD
    bool "klogd"
    default y

config APPLET_LOSETUP
    bool "losetup"
    default y

config APPLET_LSMOD
    bool "lsmod"
    default y

config APPLET_MOUNT
    bool "mount"
    default y

config APPLET_UMOUNT
    bool "umount"
    default y

config APPLET_RMMOD
    bool "rmmod"
    default y

config APPLET_DEPMOD
    bool "depmod"
    default y

config APPLET_MODPROBE
    bool "modprobe"
    default y

config APPLET_MODINFO
    bool "modinfo"
    default y

config APPLET_HD
    bool "hd"
    default y

config APPLET_HEXDUMP
    bool "hexdump"
    default y

config APPLET_HOSTID
    bool "hostid"
    default y

endmenu
```

## configs/default_defconfig
```kconfig
# <purpose of file>
#
# Copyright (C) 2026 by Anandkumar  <Truchip >
#
# Licensed under MIT
# RustFS default configuration — all features enabled
CONFIG_STATIC=y
CONFIG_INIT=y
CONFIG_INIT_RUSTFS=y
# CONFIG_INIT_SYSVINIT is not set
# CONFIG_INIT_SYSTEMD is not set
CONFIG_MDEV=y
# CONFIG_UDEV is not set
CONFIG_APPLET_CAT=y
CONFIG_APPLET_CP=y
CONFIG_APPLET_MV=y
CONFIG_APPLET_RM=y
CONFIG_APPLET_MKDIR=y
CONFIG_APPLET_RMDIR=y
CONFIG_APPLET_LS=y
CONFIG_APPLET_TOUCH=y
CONFIG_APPLET_LN=y
CONFIG_APPLET_CHMOD=y
CONFIG_APPLET_HEAD=y
CONFIG_APPLET_TAIL=y
CONFIG_APPLET_TEE=y
CONFIG_APPLET_WC=y
CONFIG_APPLET_DU=y
CONFIG_APPLET_DF=y
CONFIG_APPLET_STAT=y
CONFIG_APPLET_READLINK=y
CONFIG_APPLET_ECHO=y
CONFIG_APPLET_PRINTF=y
CONFIG_APPLET_GREP=y
CONFIG_APPLET_SED=y
CONFIG_APPLET_SORT=y
CONFIG_APPLET_UNIQ=y
CONFIG_APPLET_TR=y
CONFIG_APPLET_CUT=y
CONFIG_APPLET_PASTE=y
CONFIG_APPLET_FOLD=y
CONFIG_APPLET_REV=y
CONFIG_APPLET_NL=y
CONFIG_APPLET_BASENAME=y
CONFIG_APPLET_DIRNAME=y
CONFIG_APPLET_PWD=y
CONFIG_APPLET_REALPATH=y
CONFIG_APPLET_BASE64=y
CONFIG_APPLET_MD5SUM=y
CONFIG_APPLET_SHA256SUM=y
CONFIG_APPLET_XXD=y
CONFIG_APPLET_UNAME=y
CONFIG_APPLET_HOSTNAME=y
CONFIG_APPLET_WHOAMI=y
CONFIG_APPLET_ID=y
CONFIG_APPLET_UPTIME=y
CONFIG_APPLET_DATE=y
CONFIG_APPLET_ENV=y
CONFIG_APPLET_PRINTENV=y
CONFIG_APPLET_SLEEP=y
CONFIG_APPLET_YES=y
CONFIG_APPLET_TRUE=y
CONFIG_APPLET_FALSE=y
CONFIG_APPLET_NOHUP=y
CONFIG_APPLET_SEQ=y
CONFIG_APPLET_TTY=y
CONFIG_APPLET_WHICH=y
CONFIG_APPLET_XARGS=y
CONFIG_APPLET_FIND=y
CONFIG_APPLET_TEST=y
CONFIG_APPLET_EXPR=y
CONFIG_APPLET_ADDGROUP=y
CONFIG_APPLET_ADDUSER=y
CONFIG_APPLET_AR=y
CONFIG_APPLET_ARP=y
CONFIG_APPLET_ARPING=y
CONFIG_APPLET_AWK=y
CONFIG_APPLET_BLKID=y
CONFIG_APPLET_BUNZIP2=y
CONFIG_APPLET_BZCAT=y
CONFIG_APPLET_BZIP2=y
CONFIG_APPLET_CHGRP=y
CONFIG_APPLET_CHOWN=y
CONFIG_APPLET_CLEAR=y
CONFIG_APPLET_DD=y
CONFIG_APPLET_DELGROUP=y
CONFIG_APPLET_DELUSER=y
CONFIG_APPLET_DIFF=y
CONFIG_APPLET_DMESG=y
CONFIG_APPLET_DOS2UNIX=y
CONFIG_APPLET_FBSET=y
CONFIG_APPLET_FDISK=y
CONFIG_APPLET_FSCK=y
CONFIG_APPLET_FSYNC=y
CONFIG_APPLET_FTPD=y
CONFIG_APPLET_FTPGET=y
CONFIG_APPLET_FTPPUT=y
CONFIG_APPLET_FUSER=y
CONFIG_APPLET_GETOPT=y
CONFIG_APPLET_GETTY=y
CONFIG_APPLET_GUNZIP=y
CONFIG_APPLET_GZIP=y
CONFIG_APPLET_HD=y
CONFIG_APPLET_HEXDUMP=y
CONFIG_APPLET_HOSTID=y
CONFIG_APPLET_HTTPD=y
CONFIG_APPLET_HWCLOCK=y
CONFIG_APPLET_IFCONFIG=y
CONFIG_APPLET_IFDOWN=y
CONFIG_APPLET_IFUP=y
CONFIG_APPLET_INSMOD=y
CONFIG_APPLET_INSTALL=y
CONFIG_APPLET_IP=y
CONFIG_APPLET_IPADDR=y
CONFIG_APPLET_IPCALC=y
CONFIG_APPLET_IPCRM=y
CONFIG_APPLET_IPCS=y
CONFIG_APPLET_KILL=y
CONFIG_APPLET_KILLALL=y
CONFIG_APPLET_KLOGD=y
CONFIG_APPLET_LAST=y
CONFIG_APPLET_LENGTH=y
CONFIG_APPLET_LESS=y
CONFIG_APPLET_LOGGER=y
CONFIG_APPLET_LOGIN=y
CONFIG_APPLET_LOGNAME=y
CONFIG_APPLET_LOGREAD=y
CONFIG_APPLET_LOSETUP=y
CONFIG_APPLET_LSMOD=y
CONFIG_APPLET_MOUNT=y
CONFIG_APPLET_UMOUNT=y
CONFIG_APPLET_CHROOT=y
CONFIG_APPLET_KEXEC=y
CONFIG_APPLET_SWITCH_ROOT=y
CONFIG_APPLET_RMMOD=y
CONFIG_APPLET_DEPMOD=y
CONFIG_APPLET_MODPROBE=y
CONFIG_APPLET_MODINFO=y
CONFIG_APPLET_SH=y
CONFIG_APPLET_PS=y
CONFIG_APPLET_FREE=y
CONFIG_APPLET_SYNC=y
CONFIG_APPLET_MKTEMP=y
CONFIG_APPLET_NPROC=y
CONFIG_APPLET_TAC=y
CONFIG_APPLET_TIMEOUT=y
CONFIG_APPLET_OD=y
CONFIG_APPLET_TRUNCATE=y
CONFIG_APPLET_STRINGS=y
CONFIG_APPLET_CMP=y

# Extended applet set (added by full-config sync)
CONFIG_APPLET_ADJTIMEX=y
CONFIG_APPLET_CAL=y
CONFIG_APPLET_CHATTR=y
CONFIG_APPLET_CHRT=y
CONFIG_APPLET_CKSUM=y
CONFIG_APPLET_COMM=y
CONFIG_APPLET_DC=y
CONFIG_APPLET_DEVMEM=y
CONFIG_APPLET_DNSDOMAINNAME=y
CONFIG_APPLET_EJECT=y
CONFIG_APPLET_EXPAND=y
CONFIG_APPLET_FDFLUSH=y
CONFIG_APPLET_FDFORMAT=y
CONFIG_APPLET_FINDFS=y
CONFIG_APPLET_FLASH_LOCK=y
CONFIG_APPLET_FLASH_UNLOCK=y
CONFIG_APPLET_FREERAMDISK=y
CONFIG_APPLET_HDPARM=y
CONFIG_APPLET_IONICE=y
CONFIG_APPLET_KILLALL5=y
CONFIG_APPLET_LSATTR=y
CONFIG_APPLET_MESG=y
CONFIG_APPLET_MKFIFO=y
CONFIG_APPLET_MKNOD=y
CONFIG_APPLET_MKSWAP=y
CONFIG_APPLET_MOUNTPOINT=y
CONFIG_APPLET_NICE=y
CONFIG_APPLET_PGREP=y
CONFIG_APPLET_PIDOF=y
CONFIG_APPLET_PIVOT_ROOT=y
CONFIG_APPLET_PKILL=y
CONFIG_APPLET_RAIDAUTORUN=y
CONFIG_APPLET_RDEV=y
CONFIG_APPLET_READPROFILE=y
CONFIG_APPLET_RENICE=y
CONFIG_APPLET_RTCWAKE=y
CONFIG_APPLET_SETSID=y
CONFIG_APPLET_SHA1SUM=y
CONFIG_APPLET_SHA512SUM=y
CONFIG_APPLET_SPLIT=y
CONFIG_APPLET_SUM=y
CONFIG_APPLET_SWAPOFF=y
CONFIG_APPLET_SWAPON=y
CONFIG_APPLET_SYSCTL=y
CONFIG_APPLET_TASKSET=y
CONFIG_APPLET_TIME=y
CONFIG_APPLET_TTYSIZE=y
CONFIG_APPLET_UNEXPAND=y
CONFIG_APPLET_UNIX2DOS=y
CONFIG_APPLET_USLEEP=y
CONFIG_APPLET_UUDECODE=y
CONFIG_APPLET_UUENCODE=y
CONFIG_APPLET_WATCH=y
CONFIG_APPLET_WHO=y
CONFIG_APPLET_CATV=y
CONFIG_APPLET_MORE=y
CONFIG_APPLET_RUN_PARTS=y
CONFIG_APPLET_RUNLEVEL=y
CONFIG_APPLET_PIPE_PROGRESS=y
CONFIG_APPLET_VOLNAME=y
CONFIG_APPLET_MKPASSWD=y
CONFIG_APPLET_CRYPTPW=y
CONFIG_APPLET_RESET=y
CONFIG_APPLET_BEEP=y
CONFIG_APPLET_SETARCH=y
CONFIG_APPLET_CHVT=y
CONFIG_APPLET_DEALLOCVT=y
CONFIG_APPLET_KBD_MODE=y
CONFIG_APPLET_RDATE=y
```
